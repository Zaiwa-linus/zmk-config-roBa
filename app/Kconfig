## app/Kconfig
```kconfig
# BT Profile Layer Behavior Configuration

config ZMK_BEHAVIOR_BT_LAYER
    bool "BT Profile Layer Behavior"
    default n
    depends on ZMK_BLE
    depends on !ZMK_SPLIT || ZMK_SPLIT_ROLE_CENTRAL
    help
      A behavior that combines BT profile selection with automatic layer switching.
      - Profile 1: Layer 1 ON, Layer 2 OFF
      - Profile 2: Layer 2 ON, Layer 1 OFF
      - Others: Layer 1 OFF, Layer 2 OFF
```

## app/dts/bindings/behaviors/zmk,behavior-bt-layer.yaml
```yaml
description: BT Profile with Layer Behavior

compatible: "zmk,behavior-bt-layer"

include: one_param.yaml
```
